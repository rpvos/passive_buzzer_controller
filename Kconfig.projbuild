## Kconfig.projbuild
```kconfig
menu "Example Configuration"

    choice EXAMPLE_DAC_CHANNEL
        bool "DAC Channel Num"
        default EXAMPLE_DAC_CHANNEL_1
        help
            Select DAC channel used by the wave generator.

        config EXAMPLE_DAC_CHANNEL_1
            bool "DAC Channel 1 (GPIO25)"
        config EXAMPLE_DAC_CHANNEL_2
            bool "DAC Channel 2 (GPIO26)"
    endchoice

    config EXAMPLE_DAC_CHANNEL
        int
        default 0 if EXAMPLE_DAC_CHANNEL_1
        default 1 if EXAMPLE_DAC_CHANNEL_2

    choice EXAMPLE_WAVEFORM
        bool "Waveform"
        default EXAMPLE_WAVEFORM_SINE
        help
            Select waveform
        config EXAMPLE_WAVEFORM_SINE
            bool "Sine selected"
        config EXAMPLE_WAVEFORM_TRIANGLE
            bool "Triangle selected"
        config EXAMPLE_WAVEFORM_SAWTOOTH
            bool "Sawtooth selected"
        config EXAMPLE_WAVEFORM_SQUARE
            bool "Square selected"
    endchoice

    config EXAMPLE_LOG_VOLTAGE
        bool "Enable output voltage log"
        default n
        help
            If enabled, the output voltage(in mV) will show in log.

endmenu
```

## components/buzzer_controller/Kconfig
```kconfig
menu "Buzzer controller"

    choice DAC_CHANNEL
        bool "DAC Channel Num"
        default DAC_CHANNEL_1
        help
            Select DAC channel used by the wave generator.

        config DAC_CHANNEL_1
            bool "DAC Channel 1 (GPIO25)"
        config DAC_CHANNEL_2
            bool "DAC Channel 2 (GPIO26)"
    endchoice

    config DAC_CHANNEL
        int
        default 0 if DAC_CHANNEL_1
        default 1 if DAC_CHANNEL_2

    choice WAVEFORM
        bool "Waveform"
        default WAVEFORM_SINE
        help
            Select waveform
        config WAVEFORM_SINE
            bool "Sine selected"
        config WAVEFORM_TRIANGLE
            bool "Triangle selected"
        config WAVEFORM_SAWTOOTH
            bool "Sawtooth selected"
        config WAVEFORM_SQUARE
            bool "Square selected"
    endchoice

    config LOG_VOLTAGE
        bool "Enable output voltage log"
        default n
        help
            If enabled, the output voltage(in mV) will show in log.

endmenu
```

## components/http_controller/Kconfig
```kconfig
menu "HTTP controller"

    config ESP_WIFI_SSID
        string "WiFi SSID"
        default "BuzzerController"
        help
            SSID (network name)

    config ESP_WIFI_PASSWORD
        string "WiFi Password"
        default "password"
        help
            WiFi password (WPA or WPA2), password has to be larger then 8 characters

    config ESP_WIFI_PORT
        int "WiFi port"
        range 1 10000
        default 3500
        help 
            Port on which to acces the frequency changer

    config ESP_WIFI_CHANNEL
        int "WiFi Channel"
        range 1 13
        default 1
        help
            WiFi channel (network channel)

    config ESP_MAX_STA_CONN
        int "Maximal STA connections"
        default 4
        help
            Max number of the connected clients to acces point

    config HTTPD_MAX_REQ_HDR_LEN
        int "Max HTTP Request Header Length"
        default 512
        help
            This sets the maximum supported size of headers section in HTTP request packet to be processed by the server

    config HTTPD_MAX_URI_LEN
        int "Max HTTP URI Length"
        default 512
        help
            This sets the maximum supported size of HTTP request URI to be processed by the server
endmenu
```
